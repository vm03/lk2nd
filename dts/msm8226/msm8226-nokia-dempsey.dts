// SPDX-License-Identifier: GPL-2.0-only

/dts-v1/;

#include <skeleton.dtsi>
#include <lk2nd.h>

/ {
	model = "Microsoft Lumia 640";
	compatible = "nokia,dempsey", "qcom,msm8226", "lk2nd,device";
	qcom,msm-id = <200 0x10001>;
	qcom,board-id = <0x8 0>;
	lk2nd,smd-rpm-hack-opening;

	lk2nd,keys =
		<KEY_VOLUMEUP	106 (GPIO_PULL_UP | GPIO_ACTIVE_LOW)>;
};
